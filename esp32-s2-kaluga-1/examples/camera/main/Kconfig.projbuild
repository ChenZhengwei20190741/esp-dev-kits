## esp32-s2-kaluga-1/examples/camera/main/Kconfig.projbuild
```kconfig
menu "Example Configuration"
  
 choice CAMERA_PAD_TYPE

        prompt "camera pad type"
        default CAMERA_PAD_ESP32_S2_KALUGA_V1_3
        config CAMERA_PAD_ESP32_S2_KALUGA_V1_3
            bool "ESP32-S2-KALUGA_V1.3"
        config CAMERA_PAD_ESP32_S2_KALUGA_V1_2
            bool "ESP32-S2-KALUGA_V1.2"
        config CAMERA_PAD_ESP32_S2_KALUGA_V1_1
            bool "ESP32-S2-KALUGA_V1.1"
    endchoice
    
    choice LCD_PAD_TYPE
       prompt "LCD pad type"
        default LCD_PAD_ESP32_S2_KALUGA_V1_3
        config LCD_PAD_ESP32_S2_KALUGA_V1_3
            bool "ESP32-S2-KALUGA_V1.3"
        config LCD_PAD_ESP32_S2_KALUGA_V1_2
            bool "ESP32-S2-KALUGA_V1.2"
        config LCD_PAD_ESP32_S2_KALUGA_V1_1
            bool "ESP32-S2-KALUGA_V1.1"
    endchoice

choice CAMERA_VERSION

        prompt "Camera version"
        default CAMERA_OV2640
        config CAMERA_OV2640
            bool "OV2640"
        config CAMERA_OV3660
            bool "OV3660"
        config CAMERA_AUTO
            bool "Auto (If you choose this mode, Dont insert the Audio board!)"
        help
            Set camera version
    endchoice

    choice LCD_VERSION

        prompt "LCD version"
        default LCD_ST7789
        config LCD_ST7789
            bool "ST7789"
        config LCD_ILI9341
            bool "ILI9341"
        help
            Set LCD version
    endchoice
    
    config  CAMERA_JPEG_MODE
        bool "jpeg mode"
          config ESP_WIFI_SSID
        string "WiFi SSID"
        default "myssid"
        help
            SSID (network name) for the example to connect to.

    config ESP_WIFI_PASSWORD
        string "WiFi Password"
        default "mypassword"
        help
            WiFi password (WPA or WPA2) for the example to use.
    config ESP_WIFI_CHANNEL
        int "WiFi Channel"
        range 1 13
        default 1
        help
            WiFi channel (network channel) for the example to use.

    config ESP_MAX_STA_CONN
        int "Maximal STA connections"
        default 4
        help
            Max number of the STA connects to AP.
endmenu
```

## esp32-s2-kaluga-1/examples/camera_audio/main/Kconfig.projbuild
```kconfig
menu "Example Configuration"

config KALUGA_WIFI
    bool "WIFI config"

    config WIFI_SSID
        string "WiFi SSID"
        default "myssid"
        help
            SSID (network name) for the example to connect to.
 depends on KALUGA_WIFI
    config WIFI_PASSWORD
        string "WiFi Password"
        default "mypassword"
        help
            WiFi password (WPA or WPA2) for the example to use.

    depends on KALUGA_WIFI
    config EXAMPLE_RMT_TX_GPIO
        int "WS2812 GPIO"
        default 45
        help
            Set the GPIO number used for transmitting the RMT signal.

    config EXAMPLE_STRIP_LED_NUMBER
        int "Number of LEDS in a strip"
        default 1
        help
            A single RGB strip contains several LEDs.
            
    choice CAMERA_PAD_TYPE
    prompt "camera pad type"
        default CAMERA_PAD_ESP32_S2_KALUGA_V1_3
        config CAMERA_PAD_ESP32_S2_KALUGA_V1_3
            bool "ESP32-S2-KALUGA_V1.3"
        config CAMERA_PAD_ESP32_S2_KALUGA_V1_2
            bool "ESP32-S2-KALUGA_V1.2"
        config CAMERA_PAD_ESP32_S2_KALUGA_V1_1
            bool "ESP32-S2-KALUGA_V1.1"
    endchoice

    choice TOUCH_PAD_TYPE
        prompt "touch pad type"
        default TOUCH_PAD_ESP32_S2_KALUGA_V1_3
        config TOUCH_PAD_ESP32_S2_KALUGA_V1_3
            bool "ESP32-S2-KALUGA_V1.3"
        config TOUCH_PAD_ESP32_S2_KALUGA_V1_2
            bool "ESP32-S2-KALUGA_V1.2"
        config TOUCH_PAD_ESP32_S2_KALUGA_V1_1
            bool "ESP32-S2-KALUGA_V1.1"
    endchoice
    
    choice AUDIO_PAD_TYPE
       prompt "audio pad type"
        default AUDIO_PAD_ESP32_S2_KALUGA_V1_3
        config AUDIO_PAD_ESP32_S2_KALUGA_V1_3
            bool "ESP32-S2-KALUGA_V1.3"
        config AUDIO_PAD_ESP32_S2_KALUGA_V1_2
            bool "ESP32-S2-KALUGA_V1.2"
        config AUDIO_PAD_ESP32_S2_KALUGA_V1_1
            bool "ESP32-S2-KALUGA_V1.1"
        help
            Set the GPIO number used for transmitting the RMT signal.
    endchoice

    choice LCD_PAD_TYPE
       prompt "LCD pad type"
        default LCD_PAD_ESP32_S2_KALUGA_V1_3
        config LCD_PAD_ESP32_S2_KALUGA_V1_3
            bool "ESP32-S2-KALUGA_V1.3"
        config LCD_PAD_ESP32_S2_KALUGA_V1_2
            bool "ESP32-S2-KALUGA_V1.2"
        config LCD_PAD_ESP32_S2_KALUGA_V1_1
            bool "ESP32-S2-KALUGA_V1.1"
    endchoice

    choice CAMERA_VERSION

        prompt "Camera version"
        default CAMERA_OV2640
        config CAMERA_OV2640
            bool "OV2640"
        config CAMERA_OV3660
            bool "OV3660"
        config CAMERA_AUTO
            bool "Auto (If you choose this mode, Dont insert the Audio board!)"
        help
            Set camera version
    endchoice

     choice LCD_VERSION

        prompt "LCD version"
        default LCD_ST7789
        config LCD_ST7789
            bool "ST7789"
        config LCD_ILI9341
            bool "ILI9341"
        help
            Set LCD version
    endchoice
endmenu
```

## esp32-s2-kaluga-1/examples/camera_web/main/Kconfig.projbuild
```kconfig
menu "Example Configuration"
  
 choice CAMERA_PAD_TYPE

        prompt "camera pad type"
        default CAMERA_PAD_ESP32_S2_KALUGA_V1_3
        config CAMERA_PAD_ESP32_S2_KALUGA_V1_3
            bool "ESP32-S2-KALUGA_V1.3"
        config CAMERA_PAD_ESP32_S2_KALUGA_V1_2
            bool "ESP32-S2-KALUGA_V1.2"
        config CAMERA_PAD_ESP32_S2_KALUGA_V1_1
            bool "ESP32-S2-KALUGA_V1.1"
    endchoice
    
    choice LCD_PAD_TYPE
       prompt "LCD pad type"
        default LCD_PAD_ESP32_S2_KALUGA_V1_3
        config LCD_PAD_ESP32_S2_KALUGA_V1_3
            bool "ESP32-S2-KALUGA_V1.3"
        config LCD_PAD_ESP32_S2_KALUGA_V1_2
            bool "ESP32-S2-KALUGA_V1.2"
        config LCD_PAD_ESP32_S2_KALUGA_V1_1
            bool "ESP32-S2-KALUGA_V1.1"
    endchoice

choice CAMERA_VERSION

        prompt "Camera version"
        default CAMERA_OV2640
        config CAMERA_OV2640
            bool "OV2640"
        config CAMERA_OV3660
            bool "OV3660"
        config CAMERA_AUTO
            bool "Auto (If you choose this mode, Dont insert the Audio board!)"
        help
            Set camera version
    endchoice

    choice LCD_VERSION

        prompt "LCD version"
        default LCD_ST7789
        config LCD_ST7789
            bool "ST7789"
        config LCD_ILI9341
            bool "ILI9341"
        help
            Set LCD version
    endchoice
    
    config  CAMERA_JPEG_MODE
        bool "jpeg mode"
       menu "WiFi Settings"
config ESP_WIFI_SSID
    string "WiFi STA SSID"
    default ""
    help
    WiFi SSID (network name) to connect to or empty for Off.

config ESP_WIFI_PASSWORD
    string "WiFi STA Password"
    default ""
    help
    WiFi Password if WEP/WPA/WPA2 or empty if Open.
    
config ESP_WIFI_AP_SSID
    string "WiFi AP SSID"
    default "ESP32-Camera"
    help
	AP SSID (network name) to create or empty for Off.

config ESP_WIFI_AP_PASSWORD
    string "WiFi AP Password"
    default ""
    help
	AP password for WPA2 or empty for Open.

config SERVER_IP
    string "WiFi AP IP Address"
    default "192.168.4.1"
    help
        IP address that the ESP will assign to it's AP interface. You can use this IP to connect to the camera after flashing.

config ESP_MAXIMUM_RETRY
    int "Maximum retry"
    default 5
    help
    Set the Maximum retry to avoid station reconnecting to the AP unlimited when the AP is really inexistent.
endmenu
endmenu
```
